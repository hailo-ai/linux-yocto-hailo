## Documentation/devicetree/bindings/sound/designware-i2s.txt
```
DesignWare I2S controller

Required properties:
 - compatible : Must be "snps,designware-i2s" or "hailo15,designware-i2s"
 - reg : Must contain the I2S core's registers location and length
 - clocks : Pairs of phandle and specifier referencing the controller's
   clocks. The controller expects one clock: the clock used as the sampling
   rate reference clock sample.
 - clock-names : "i2sclk" for the sample rate reference clock.
 - dmas: Pairs of phandle and specifier for the DMA channels that are used by
   the core. The core expects one or two dma channels: one for transmit and
   one for receive.
 - dma-names : "tx" for the transmit channel, "rx" for the receive channel.

Required properties for hailo15,designware-i2s only:
 - rx-sample-pace : recording fix samples offsets pattern
 - rx-sample-cmp-to : comparison options for samples paces pattern synchronization:
   expected pattern samples value to sync:
   * "zero" : Compare current sample to zero.
   * "prev-val" : Compare current sample to the previous sample.
 - tx-sample-offset : playback start samples pattern fixes starting from sample <xxx>.
 - tx-sample-pace: playback fix samples offsets pattern.
 - rx-sample-pace-pattern-repetitions: number of consecutive pattern repetitions required for recording synchronization.

Optional properties:
 - interrupts: The interrupt line number for the I2S controller. Add this
   parameter if the I2S controller that you are using does not support DMA.

For more details on the 'dma', 'dma-names', 'clock' and 'clock-names'
properties please check:
	* resource-names.txt
	* clock/clock-bindings.txt
	* dma/dma.txt

Examples #1:

	soc_i2s: i2s@7ff90000 {
		compatible = "snps,designware-i2s";
		reg = <0x0 0x7ff90000 0x0 0x1000>;
		clocks = <&scpi_i2sclk 0>;
		clock-names = "i2sclk";
		#sound-dai-cells = <0>;
		dmas = <&dma0 5>;
		dma-names = "tx";
	};


Examples #2:
	// Recording:
	// - Fix samples offsets pattern 59, 59, 58
	// - Comparison options for samples paces pattern "zero"
	// Playback:
	// - Fix samples offsets pattern 58, 58, 57
	// - Start samples pattern fixes starting from sample 7

	soc_i2s: i2s@7ff90000 {
		compatible = "hailo,hailo15-designware-i2s-scu-dma";
		reg = <0x0 0x7ff90000 0x0 0x1000>;
		clocks = <&scpi_i2sclk 0>;
		clock-names = "i2sclk";
		#sound-dai-cells = <0>;

		rx-sample-pace = <59 59 58>;
		rx-sample-cmp-to = "zero";
		tx-sample-offset = <7>;
		tx-sample-pace = <58 58 57>;
		rx-sample-pace-pattern-repetitions = <2>;
	};
```

## drivers/firmware/hailo/Kconfig
```kconfig
# SPDX-License-Identifier: GPL-2.0-or-later
config HAILO_XRP
    bool "Hailo XRP (Xtensa remote processing) driver"
    help
      This enables DSP IPC protocol between host AP (Linux)
      and the firmware running on DSP.

config HAILO_XRP_DEBUG
    bool "Hailo XRP verbose debug messages"
    help
      Say Y here if you want the XRP driver to produce a bunch of
      debug messages to the system log. Select this if you are having a
      problem with the driver and want to see more of what is
      going on.

      If you are unsure about this, say N here.

config HAILO_SCU_LOG
    bool "Hailo SCU (System Control Unit) log driver"
    help
      This enables reading logs from SCU firmware.
```

## drivers/media/platform/hailo/hailo15/Kconfig
```kconfig
# SPDX-License-Identifier: GPL-2.0-only
config VIDEO_HAILO15
	bool "Hailo15 video Devices"
	depends on MEDIA_SUPPORT
	select VIDEO_V4L2
	select VIDEO_V4L2_SUBDEV_API
	select V4L2_FWNODE
	select VIDEOBUF2_DMA_CONTIG
	help
	  If you have a media device from hailo15 series, say Y.

	  Note that this option doesn't include new drivers in the kernel:
	  saying N will just cause Kconfig to skip all the questions about
	  hailo15 media devices.

if VIDEO_HAILO15

config VIDEO_HAILO15_VIDEO_CAPTURE
	tristate "Hailo15 video capture device"

config VIDEO_HAILO15_PIX_MUX
	tristate "Hailo15 pixel-mux driver"
	help
	  Support for the hailo15 pixel mux driver.

	  To compile this driver as a module, choose M here: the module will be
	  called hailo15-pixel-mux.

config VIDEO_HAILO15_RXWRAPPER
	tristate "Hailo15 rxwrapper driver"
	help
	  Support for the hailo15 rxwrapper driver.

	  To compile this driver as a module, choose M here: the module will be
	  called hailo15-rxwrapper.

config VIDEO_HAILO15_ISP
	tristate "Hailo15 ISP driver"
	help
		Support for Hailo15 ISP

config VIDEO_HAILO15_AF_MONITOR_EXAMPLE
	tristate "Hailo15 af monitor example"
	help
		Support for Hailo15 AF

endif
```

## drivers/pinctrl/hailo/Kconfig
```kconfig
# SPDX-License-Identifier: GPL-2.0
config PINCTRL_HAILO15
	bool "HAILO15 pinctrl driver"
	depends on I2C
	depends on ARCH_HAILO15
	select PINMUX
	select GENERIC_PINCONF
	help
	  Say yes here to provide support for HAILO15 driver.
```

## drivers/soc/hailo/Kconfig
```kconfig
# SPDX-License-Identifier: GPL-2.0-only
#
# Hailo SoCs driver
#

config SOC_HAILO
	bool "SoC bus device for the Hailo SoCs"
	depends on ARCH_HAILO15
	depends on HAILO_SCMI_PROTOCOL
	select SOC_BUS
	help
	  Include support for the SoC info driver for Hailo SoCs.
```

## sound/soc/dwc/Kconfig
```kconfig
# SPDX-License-Identifier: GPL-2.0-only
config SND_DESIGNWARE_I2S
	tristate "Synopsys I2S Device Driver"
	depends on HAVE_CLK
	select SND_SOC_GENERIC_DMAENGINE_PCM
	help
	 Say Y or M if you want to add support for I2S driver for
	 Synopsys designware I2S device. The device supports up to
	 a maximum of 8 channels each for play and record.

config SND_DESIGNWARE_PCM
	bool "PCM PIO extension for I2S driver"
	depends on SND_DESIGNWARE_I2S
	help
	 Say Y or N if you want to add a custom ALSA extension that registers
	 a PCM and uses PIO to transfer data.

	 This functionality is specially suited for I2S devices that don't have
	 DMA support.

config SND_DESIGNWARE_HAILO15_STATS
	bool "PCM PIO Hailo15 stats"
	depends on SND_DESIGNWARE_PCM
	default n
	help
	 Say Y if you want to get Hailo15 IRQ execution and interval statistics.

	 This functionality is specially suited for I2S devices that don't have
	 DMA support.
```
