// SPDX-License-Identifier: GPL-2.0
/*
 * Copyright (c) 2019-2026 Hailo Technologies Ltd. All rights reserved.
 */
/dts-v1/;
/plugin/;

&sensor_0 {
    status = "okay";
    compatible = "sony,imx678";
    clock-frequency = <24000000>;
};

&sensor_out_csi2rx {
    link-frequencies = /bits/ 64 <891000000 1440000000 1782000000>;
};
