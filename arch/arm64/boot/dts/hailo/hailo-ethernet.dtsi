    eth: ethernet@1b5000 {
        status = "disabled";
        compatible = "hailo,hailo15-gem";
        reg = <0 0x1b5000 0 0x3000>;
        interrupts =
            <GIC_SPI HW_INTERRUPTS__ETHERNET_0_IRQ IRQ_TYPE_LEVEL_HIGH>,
            <GIC_SPI HW_INTERRUPTS__ETHERNET_1_IRQ IRQ_TYPE_LEVEL_HIGH>,
            <GIC_SPI HW_INTERRUPTS__ETHERNET_2_IRQ IRQ_TYPE_LEVEL_HIGH>,
            <GIC_SPI HW_INTERRUPTS__ETHERNET_3_IRQ IRQ_TYPE_LEVEL_HIGH>,
            <GIC_SPI HW_INTERRUPTS__ETHERNET_4_IRQ IRQ_TYPE_LEVEL_HIGH>,
            <GIC_SPI HW_INTERRUPTS__ETHERNET_5_IRQ IRQ_TYPE_LEVEL_HIGH>,
            <GIC_SPI HW_INTERRUPTS__ETHERNET_6_IRQ IRQ_TYPE_LEVEL_HIGH>,
            <GIC_SPI HW_INTERRUPTS__ETHERNET_7_IRQ IRQ_TYPE_LEVEL_HIGH>,
            <GIC_SPI HW_INTERRUPTS__ETHERNET_8_IRQ IRQ_TYPE_LEVEL_HIGH>,
            <GIC_SPI HW_INTERRUPTS__ETHERNET_9_IRQ IRQ_TYPE_LEVEL_HIGH>,
            <GIC_SPI HW_INTERRUPTS__ETHERNET_10_IRQ IRQ_TYPE_LEVEL_HIGH>,
            <GIC_SPI HW_INTERRUPTS__ETHERNET_11_IRQ IRQ_TYPE_LEVEL_HIGH>,
            <GIC_SPI HW_INTERRUPTS__ETHERNET_12_IRQ IRQ_TYPE_LEVEL_HIGH>,
            <GIC_SPI HW_INTERRUPTS__ETHERNET_13_IRQ IRQ_TYPE_LEVEL_HIGH>,
            <GIC_SPI HW_INTERRUPTS__ETHERNET_14_IRQ IRQ_TYPE_LEVEL_HIGH>,
            <GIC_SPI HW_INTERRUPTS__ETHERNET_15_IRQ IRQ_TYPE_LEVEL_HIGH>;
        clocks = <&scmi_clk HAILO15_SCMI_CLOCK_IDX_ETHERNET_PCLK>, <&scmi_clk HAILO15_SCMI_CLOCK_IDX_ETHERNET_ACLK>;
        clock-names = "pclk", "hclk";
        phy-mode = "rgmii-id";
        resets = <&scmi_reset HAILO15_SCMI_RESET_IDX_ETHERNET>;
        reset-names = "ethernet-rst";
    };