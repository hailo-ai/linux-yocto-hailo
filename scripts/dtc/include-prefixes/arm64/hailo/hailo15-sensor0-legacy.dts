// SPDX-License-Identifier: GPL-2.0
/*
 * Copyright (c) 2019-2026 Hailo Technologies Ltd. All rights reserved.
 */
/dts-v1/;
/plugin/;

&sensor_0 {
    status = "okay";
    compatible = "sony,imx334", "sony,imx664", "sony,imx675", "sony,imx678", "sony,imx715", "sony,imx307";
    clock-frequency = <24000000>;
};

&sensor_out_csi2rx {
    link-frequencies = /bits/ 64 <720000000 891000000 111370000 1188000000 1440000000 1782000000 222750000>;
};
