// SPDX-License-Identifier:     GPL-2.0
/*
 * Copyright (c) 2019-2024 Hailo Technologies Ltd. All rights reserved.
 */

/dts-v1/;
#include "hailo10-m2-base.dtsi"
#include "hailo10-4gb-cma-config.dtsi"

/ {
    memory {
        device_type = "memory";
        reg = <0x00000000 0x80000000 0x00000002 0x00000000>;
    };
};