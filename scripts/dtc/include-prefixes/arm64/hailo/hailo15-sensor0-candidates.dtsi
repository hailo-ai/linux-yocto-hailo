// SPDX-License-Identifier: GPL-2.0
/*
 * Copyright (c) 2019-2026 Hailo Technologies Ltd. All rights reserved.
 *
 * Camera port 0 as it was before U-Boot detection existed: the candidate list
 * for the kernel to probe until one sensor binds. For the boards that do not
 * run detection in u-boot at all.
 *
 * hailo15-vision.dtsi leaves sensor_0 a bare connector for a per-sensor
 * overlay to fill in, which is right where U-Boot picks that overlay and
 * wrong where it cannot. On the H15 EVBs it cannot: the module's power and
 * reset sit behind a CPLD that U-Boot is unable to program- it cannot even
 * read the CPLD- so the module never answers on i2c, nothing is detected,
 * no overlay is applied, and the port would stay empty. The H15L EVB has no
 * such CPLD but was not validated for detection. All those build
 * U-Boot without CONFIG_HAILO_SENSOR_DETECT.
 *
 * Only port 0 needs this. The boards with a second camera describe sensor_1
 * in their own board file, and that list was never moved into an overlay.
 */

&sensor_0 {
    compatible = "sony,imx334", "sony,imx664", "sony,imx675", "sony,imx678", "sony,imx715", "sony,imx307";
    clock-frequency = <24000000>;
};

&sensor_out_csi2rx {
    link-frequencies = /bits/ 64 <720000000 891000000 111370000 1188000000 1440000000 1782000000 222750000>;
};
