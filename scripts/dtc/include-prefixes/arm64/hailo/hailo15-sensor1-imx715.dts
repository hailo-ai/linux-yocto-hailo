// SPDX-License-Identifier: GPL-2.0
/*
 * Copyright (c) 2019-2026 Hailo Technologies Ltd. All rights reserved.
 */
/dts-v1/;
/plugin/;
&{/} {
    imx_715_sensor_clk_1: imx_715_sensor_clk_1 {
        compatible = "fixed-clock";
        #clock-cells = <0>;
        clock-frequency = <37125000>;
    };
};

&sensor_1 {
    status = "okay";
    compatible = "sony,imx715";
    clocks = <&imx_715_sensor_clk_1>;
    clock-names = "inclk";
    clock-frequency = <37125000>;
};

&sensor_out_csi2rx1 {
    link-frequencies = /bits/ 64 <720000000 1782000000>;
};
